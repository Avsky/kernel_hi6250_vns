## arch/arm64/configs/veno_hi6250_defconfig
```kconfig
CONFIG_LOCALVERSION="-veno"
CONFIG_SYSVIPC=y
CONFIG_POSIX_MQUEUE=y
CONFIG_AUDIT=y
CONFIG_NO_HZ=y
CONFIG_HIGH_RES_TIMERS=y
CONFIG_BSD_PROCESS_ACCT=y
CONFIG_BSD_PROCESS_ACCT_V3=y
CONFIG_TASKSTATS=y
CONFIG_TASK_DELAY_ACCT=y
CONFIG_TASK_XACCT=y
CONFIG_TASK_IO_ACCOUNTING=y
CONFIG_IKCONFIG=y
CONFIG_LOG_BUF_SHIFT=19
CONFIG_CGROUPS=y
CONFIG_CGROUP_DEBUG=y
CONFIG_CGROUP_FREEZER=y
CONFIG_CGROUP_PIDS=y
CONFIG_CGROUP_PIDS_NOTIFY_USER=y
CONFIG_CGROUP_IONICE=y
CONFIG_CPUSETS=y
CONFIG_CGROUP_CPUACCT=y
CONFIG_RESOURCE_COUNTERS=y
CONFIG_CGROUP_SCHED=y
CONFIG_RT_GROUP_SCHED=y
CONFIG_BLK_DEV_INITRD=y
CONFIG_KALLSYMS_ALL=y
CONFIG_EMBEDDED=y
CONFIG_PROFILING=y
CONFIG_MODULES=y
CONFIG_MODULE_UNLOAD=y
CONFIG_HW_SYSTEM_WR_PROTECT=y
CONFIG_HISI_BLOCK_FREQUENCE_CONTROL=y
CONFIG_IOSCHED_ROW=y
CONFIG_IOSCHED_BFQ=y
CONFIG_CGROUP_BFQIO=y
CONFIG_DEFAULT_BFQ=y
CONFIG_ARCH_HI6250=y
CONFIG_ARCH_HI3XXX=y
CONFIG_ARCH_HISI=y
# CONFIG_TTBR1_48BITS_VARANGE_BUG is not set
CONFIG_BALONG_MODEM_REMOVE_HEAD=y
CONFIG_HISI_BALONG_MODEM=y
CONFIG_HISI_BALONG_MODEM_HI3650=y
CONFIG_ARM_TIMER_SP804=y
CONFIG_SMP=y
CONFIG_SCHED_MC=y
CONFIG_DISABLE_CPU_SCHED_DOMAIN_BALANCE=y
CONFIG_SCHED_HMP=y
CONFIG_HMP_VARIABLE_SCALE=y
CONFIG_HMP_FREQUENCY_INVARIANT_SCALE=y
CONFIG_SCHED_HMP_BOOST=y
CONFIG_PREEMPT=y
CONFIG_ARMV7_COMPAT=y
CONFIG_FLATMEM_MANUAL=y
CONFIG_SHRINK_MEMORY=y
CONFIG_KSM=y
CONFIG_CMA=y
CONFIG_CMA_DEBUG=y
CONFIG_PROCESS_RECLAIM=y
CONFIG_ZSMALLOC=y
CONFIG_SECCOMP=y
CONFIG_ARMV8_DEPRECATED=y
CONFIG_SWP_EMULATION=y
CONFIG_CMDLINE="console=ttyAMA0"
# CONFIG_CORE_DUMP_DEFAULT_ELF_HEADERS is not set
CONFIG_COMPAT=y
CONFIG_PM_AUTOSLEEP=y
CONFIG_PM_WAKELOCKS=y
CONFIG_PM_RUNTIME=y
CONFIG_PM_DEBUG=y
CONFIG_WQ_POWER_EFFICIENT_DEFAULT=y
CONFIG_CPU_FREQ=y
CONFIG_CPU_FREQ_STAT_DETAILS=y
CONFIG_CPU_FREQ_GOV_POWERSAVE=y
CONFIG_CPU_FREQ_GOV_USERSPACE=y
CONFIG_CPU_FREQ_GOV_ONDEMAND=y
CONFIG_CPU_FREQ_GOV_INTERACTIVE=y
CONFIG_ARCH_HISI_MAXFREQ=y
CONFIG_CPU_FREQ_GOV_CONSERVATIVE=y
CONFIG_ARM_BIG_LITTLE_CPUFREQ=y
CONFIG_ARM_DT_BL_CPUFREQ=y
CONFIG_HISI_CPUFREQ=y
CONFIG_CPU_IDLE=y
CONFIG_CPU_IDLE_MULTIPLE_DRIVERS=y
CONFIG_HISI_MULTIDRV_CPUIDLE=y
CONFIG_NET=y
CONFIG_PACKET=y
CONFIG_UNIX=y
CONFIG_XFRM_USER=y
CONFIG_NET_KEY=y
CONFIG_INET=y
CONFIG_IP_ADVANCED_ROUTER=y
CONFIG_IP_MULTIPLE_TABLES=y
CONFIG_IP_ROUTE_MULTIPATH=y
CONFIG_IP_ROUTE_VERBOSE=y
CONFIG_IP_PNP=y
CONFIG_IP_PNP_DHCP=y
CONFIG_IP_PNP_BOOTP=y
CONFIG_INET_ESP=y
CONFIG_HW_WIFIPRO=y
CONFIG_HW_WIFIPRO_PROC=y
CONFIG_HW_WIFI=y
CONFIG_IPV6=y
CONFIG_IPV6_PRIVACY=y
CONFIG_IPV6_ROUTER_PREF=y
CONFIG_IPV6_ROUTE_INFO=y
CONFIG_IPV6_OPTIMISTIC_DAD=y
CONFIG_INET6_AH=y
CONFIG_INET6_ESP=y
CONFIG_INET6_IPCOMP=y
CONFIG_IPV6_MIP6=y
CONFIG_IPV6_MULTIPLE_TABLES=y
CONFIG_IPV6_SUBTREES=y
CONFIG_NETFILTER=y
CONFIG_NF_CONNTRACK=y
CONFIG_NF_CONNTRACK_EVENTS=y
CONFIG_NF_CT_PROTO_DCCP=y
CONFIG_NF_CT_PROTO_SCTP=y
CONFIG_NF_CT_PROTO_UDPLITE=y
CONFIG_NF_CONNTRACK_AMANDA=y
CONFIG_NF_CONNTRACK_FTP=y
CONFIG_NF_CONNTRACK_H323=y
CONFIG_NF_CONNTRACK_IRC=y
CONFIG_NF_CONNTRACK_NETBIOS_NS=y
CONFIG_NF_CONNTRACK_PPTP=y
CONFIG_NF_CONNTRACK_SANE=y
CONFIG_NF_CONNTRACK_SIP=y
CONFIG_NF_CONNTRACK_TFTP=y
CONFIG_NF_CT_NETLINK=y
CONFIG_NETFILTER_TPROXY=y
CONFIG_NETFILTER_XT_TARGET_CLASSIFY=y
CONFIG_NETFILTER_XT_TARGET_CONNMARK=y
CONFIG_NETFILTER_XT_TARGET_IDLETIMER=y
CONFIG_NETFILTER_XT_TARGET_MARK=y
CONFIG_NETFILTER_XT_TARGET_NFLOG=y
CONFIG_NETFILTER_XT_TARGET_NFQUEUE=y
CONFIG_NETFILTER_XT_TARGET_TPROXY=y
CONFIG_NETFILTER_XT_TARGET_TRACE=y
CONFIG_NETFILTER_XT_TARGET_TCPMSS=y
CONFIG_NETFILTER_XT_MATCH_COMMENT=y
CONFIG_NETFILTER_XT_MATCH_CONNBYTES=y
CONFIG_NETFILTER_XT_MATCH_CONNLIMIT=y
CONFIG_NETFILTER_XT_MATCH_CONNMARK=y
CONFIG_NETFILTER_XT_MATCH_CONNTRACK=y
CONFIG_NETFILTER_XT_MATCH_HASHLIMIT=y
CONFIG_NETFILTER_XT_MATCH_HELPER=y
CONFIG_NETFILTER_XT_MATCH_IPRANGE=y
CONFIG_NETFILTER_XT_MATCH_LENGTH=y
CONFIG_NETFILTER_XT_MATCH_LIMIT=y
CONFIG_NETFILTER_XT_MATCH_MAC=y
CONFIG_NETFILTER_XT_MATCH_MARK=y
CONFIG_NETFILTER_XT_MATCH_MULTIPORT=y
CONFIG_NETFILTER_XT_MATCH_POLICY=y
CONFIG_NETFILTER_XT_MATCH_PKTTYPE=y
CONFIG_NETFILTER_XT_MATCH_QTAGUID=y
CONFIG_NETFILTER_XT_MATCH_QUOTA=y
CONFIG_NETFILTER_XT_MATCH_QUOTA2=y
CONFIG_NETFILTER_XT_MATCH_QUOTA2_LOG=y
CONFIG_NETFILTER_XT_MATCH_SOCKET=y
CONFIG_NETFILTER_XT_MATCH_STATE=y
CONFIG_NETFILTER_XT_MATCH_STATISTIC=y
CONFIG_NETFILTER_XT_MATCH_STRING=y
CONFIG_NETFILTER_XT_MATCH_TIME=y
CONFIG_NETFILTER_XT_MATCH_U32=y
CONFIG_NF_CONNTRACK_IPV4=y
CONFIG_IP_NF_IPTABLES=y
CONFIG_IP_NF_MATCH_AH=y
CONFIG_IP_NF_MATCH_ECN=y
CONFIG_IP_NF_MATCH_TTL=y
CONFIG_IP_NF_FILTER=y
CONFIG_IP_NF_TARGET_REJECT=y
CONFIG_IP_NF_TARGET_REJECT_SKERR=y
CONFIG_NF_NAT_IPV4=y
CONFIG_IP_NF_TARGET_MASQUERADE=y
CONFIG_IP_NF_TARGET_NETMAP=y
CONFIG_IP_NF_TARGET_REDIRECT=y
CONFIG_IP_NF_MANGLE=y
CONFIG_IP_NF_RAW=y
CONFIG_IP_NF_ARPTABLES=y
CONFIG_IP_NF_ARPFILTER=y
CONFIG_IP_NF_ARP_MANGLE=y
CONFIG_NF_CONNTRACK_IPV6=y
CONFIG_IP6_NF_IPTABLES=y
CONFIG_IP6_NF_FILTER=y
CONFIG_IP6_NF_TARGET_REJECT=y
CONFIG_IP6_NF_TARGET_REJECT_SKERR=y
CONFIG_IP6_NF_MANGLE=y
CONFIG_IP6_NF_RAW=y
CONFIG_NET_SCHED=y
CONFIG_NET_SCH_HTB=y
CONFIG_NET_CLS_U32=y
CONFIG_NET_EMATCH=y
CONFIG_NET_EMATCH_U32=y
CONFIG_NET_CLS_ACT=y
CONFIG_NET_ACT_POLICE=y
CONFIG_NET_ACT_GACT=y
CONFIG_NET_ACT_MIRRED=y
CONFIG_CFG80211=y
CONFIG_CFG80211_WEXT=y
CONFIG_ATFDRIVER=y
CONFIG_DEVTMPFS=y
CONFIG_DMA_CMA=y
CONFIG_HISI_CMA_RESERVE_MEMORY=y
CONFIG_CMA_SIZE_MBYTES=32
CONFIG_MTD=y
CONFIG_BALONG_MTD=y
CONFIG_MTD_CMDLINE_PARTS=y
CONFIG_HISI_NVE=y
CONFIG_MTD_BLOCK=y
CONFIG_MTD_OOPS=y
CONFIG_MTD_BLOCK2MTD=y
CONFIG_ZRAM=y
CONFIG_ZRAM_LZ4_COMPRESS=y
CONFIG_BLK_DEV_LOOP=y
CONFIG_BLK_DEV_CRYPTOLOOP=y
CONFIG_BLK_DEV_RAM=y
CONFIG_BLK_DEV_RAM_COUNT=4
CONFIG_BLK_DEV_RAM_SIZE=8192
CONFIG_BLK_DEV_XIP=y
CONFIG_CDROM_PKTCDVD=y
CONFIG_UID_CPUTIME=y
CONFIG_SOUNDTRIGGER_EVENT=y
CONFIG_SCSI=y
CONFIG_BLK_DEV_SD=y
CONFIG_SCSI_MULTI_LUN=y
CONFIG_MD=y
CONFIG_BLK_DEV_DM=y
CONFIG_DM_DEBUG=y
CONFIG_DM_CRYPT=y
CONFIG_DM_UEVENT=y
CONFIG_NETDEVICES=y
CONFIG_TUN=y
CONFIG_PPP=y
CONFIG_PPP_BSDCOMP=y
CONFIG_PPP_DEFLATE=y
CONFIG_PPP_FILTER=y
CONFIG_PPP_MPPE=y
CONFIG_PPP_MULTILINK=y
CONFIG_PPPOE=m
CONFIG_PPPOLAC=y
CONFIG_PPPOPNS=y
CONFIG_PPP_ASYNC=y
CONFIG_PPP_SYNC_TTY=y
# CONFIG_WLAN is not set
CONFIG_INPUT_EVDEV=y
CONFIG_KEYBOARD_HISI_GPIO_KEY=y
CONFIG_INPUT_TOUCHSCREEN=y
CONFIG_TOUCHSCREEN_CYPRESS_CYTTSP4=y
CONFIG_TOUCHSCREEN_CYPRESS_CYTTSP4_DEVICETREE_SUPPORT=y
# CONFIG_TOUCHSCREEN_CYPRESS_CYTTSP4_PROXIMITY is not set
CONFIG_TOUCHSCREEN_CYPRESS_CYTTSP4_BINARY_FW_UPGRADE=y
CONFIG_TOUCHSCREEN_CYPRESS_CYTTSP4_MANUAL_TTCONFIG_UPGRADE=y
CONFIG_TOUCHSCREEN_CYPRESS_CYTTSP4_USE_FW_BIN_FILE=y
CONFIG_TOUCHSCREEN_CYPRESS_CYTTSP4_DEVICE_ACCESS=y
CONFIG_TOUCHSCREEN_CYPRESS_CYTTSP4_LOADER=y
CONFIG_TOUCHSCREEN_CYPRESS_CYTTSP4_DEBUG_MODULE=y
CONFIG_INPUT_MISC=y
CONFIG_HISI_POWERKEY=y
CONFIG_INPUT_UINPUT=y
CONFIG_INPUT_GPIO=y
CONFIG_HISI_VIBRATOR=y
# CONFIG_SERIO_I8042 is not set
CONFIG_LEGACY_PTY_COUNT=16
CONFIG_SERIAL_AMBA_PL011=y
CONFIG_SERIAL_AMBA_PL011_CONSOLE=y
CONFIG_HISI_UART_OVERSAMPLING=y
# CONFIG_HW_RANDOM is not set
CONFIG_I2C_DESIGNWARE_PLATFORM=y
CONFIG_HISI_I2C_DESIGNWARE=y
CONFIG_SPI_DEBUG=y
CONFIG_HISI_SPI=y
CONFIG_SPI_PL022=y
CONFIG_PINCTRL_SINGLE=y
CONFIG_PINCTRL_HI6402=y
CONFIG_GPIOLIB=y
CONFIG_GPIO_SYSFS=y
CONFIG_GPIO_PL061=y
CONFIG_GPIO_HI6402=y
CONFIG_POWER_HISI=y
CONFIG_HISI_BATTERY_DATA=y
CONFIG_HISI_BCI_BATTERY=y
CONFIG_HISI_CHARGER=y
CONFIG_HISI_CHARGER_ARCH=y
CONFIG_SCHARGER_V200=y
CONFIG_HISI_COUL=y
CONFIG_HISI_COUL_HI6555V100=y
CONFIG_HISI_COUL_TEST=y
CONFIG_SENSORS_INA231=y
CONFIG_THERMAL=y
CONFIG_THERMAL_WRITABLE_TRIPS=y
CONFIG_THERMAL_DEFAULT_GOV_USER_SPACE=y
CONFIG_THERMAL_GOV_POWER_ALLOCATOR=y
CONFIG_CPU_THERMAL=y
CONFIG_DEVFREQ_THERMAL=y
CONFIG_THERMAL_EMULATION=y
CONFIG_HISI_IPA_THERMAL=y
CONFIG_HISI_THERMAL_TSENSOR=y
CONFIG_HISI_THERMAL_PERIPHERAL=y
CONFIG_ARM_SP805_WATCHDOG=y
CONFIG_HISI_SP805_WATCHDOG=y
CONFIG_HISI_IP_CORE=y
CONFIG_HISI_FREQ_AUTODOWN=y
CONFIG_HISI_PMIC=y
CONFIG_HISI_PMIC_MNTN=y
CONFIG_HISI_CHARGER_POWER=y
CONFIG_MFD_HI3630_ASP_IRQ=y
CONFIG_REGULATOR=y
CONFIG_HISI_IP_REGULATOR=y
CONFIG_REGULATOR_HI6250=y
CONFIG_REGULATOR_IP_DEBUG=y
CONFIG_HISI_REGULATOR=y
CONFIG_HISI_CHARGER_REGULATOR=y
CONFIG_MEDIA_SUPPORT=y
CONFIG_MEDIA_CAMERA_SUPPORT=y
CONFIG_USE_CAMERA3_ARCH=y
CONFIG_HISI_CAMERA_SCHARGER=y
CONFIG_HUAWEI_CAMERA_USE_EXTISP=y
CONFIG_HISI_CAMERA_HISTAR_ISPV110=y
CONFIG_IMAGINATION_D5500_VCODEC=y
CONFIG_FB=y
CONFIG_HISI_FB_6250=y
CONFIG_LOGO=y
# CONFIG_LOGO_LINUX_MONO is not set
# CONFIG_LOGO_LINUX_VGA16 is not set
CONFIG_SOUND=y
CONFIG_SND=y
CONFIG_SND_SOC=y
CONFIG_SND_SOC_PCM_HI3650=y
CONFIG_SND_HI6250_HI6402=y
CONFIG_SND_HI6250_HI6555C=y
CONFIG_SND_HI3650_HI6402=y
CONFIG_SND_SOC_CODEC_HISSC=y
CONFIG_SND_SOC_CODEC_HI6555C=y
CONFIG_HID_BATTERY_STRENGTH=y
CONFIG_HIDRAW=y
CONFIG_UHID=y
CONFIG_HID_A4TECH=y
CONFIG_HID_ACRUX=y
CONFIG_HID_ACRUX_FF=y
CONFIG_HID_APPLE=y
CONFIG_HID_APPLEIR=y
CONFIG_HID_AUREAL=y
CONFIG_HID_BELKIN=y
CONFIG_HID_CHERRY=y
CONFIG_HID_CHICONY=y
CONFIG_HID_PRODIKEYS=y
CONFIG_HID_CYPRESS=y
CONFIG_HID_DRAGONRISE=y
CONFIG_DRAGONRISE_FF=y
CONFIG_HID_EMS_FF=y
CONFIG_HID_ELECOM=y
CONFIG_HID_EZKEY=y
CONFIG_HID_HOLTEK=y
CONFIG_HOLTEK_FF=y
CONFIG_HID_KEYTOUCH=y
CONFIG_HID_KYE=y
CONFIG_HID_UCLOGIC=y
CONFIG_HID_WALTOP=y
CONFIG_HID_GYRATION=y
CONFIG_HID_ICADE=y
CONFIG_HID_TWINHAN=y
CONFIG_HID_KENSINGTON=y
CONFIG_HID_LCPOWER=y
CONFIG_HID_LENOVO_TPKBD=y
CONFIG_HID_LOGITECH=y
CONFIG_HID_LOGITECH_DJ=y
CONFIG_LOGITECH_FF=y
CONFIG_LOGIRUMBLEPAD2_FF=y
CONFIG_LOGIG940_FF=y
CONFIG_HID_MAGICMOUSE=y
CONFIG_HID_MICROSOFT=y
CONFIG_HID_MONTEREY=y
CONFIG_HID_MULTITOUCH=y
CONFIG_HID_NTRIG=y
CONFIG_HID_ORTEK=y
CONFIG_HID_PANTHERLORD=y
CONFIG_PANTHERLORD_FF=y
CONFIG_HID_PETALYNX=y
CONFIG_HID_PICOLCD=y
CONFIG_HID_PICOLCD_FB=y
CONFIG_HID_PICOLCD_LEDS=y
CONFIG_HID_PRIMAX=y
CONFIG_HID_PS3REMOTE=y
CONFIG_HID_ROCCAT=y
CONFIG_HID_SAITEK=y
CONFIG_HID_SAMSUNG=y
CONFIG_HID_SONY=y
CONFIG_HID_SPEEDLINK=y
CONFIG_HID_STEELSERIES=y
CONFIG_HID_SUNPLUS=y
CONFIG_HID_GREENASIA=y
CONFIG_GREENASIA_FF=y
CONFIG_HID_SMARTJOYPLUS=y
CONFIG_SMARTJOYPLUS_FF=y
CONFIG_HID_TIVO=y
CONFIG_HID_TOPSEED=y
CONFIG_HID_THINGM=y
CONFIG_HID_THRUSTMASTER=y
CONFIG_THRUSTMASTER_FF=y
CONFIG_HID_WACOM=y
CONFIG_HID_WIIMOTE=y
CONFIG_HID_ZEROPLUS=y
CONFIG_ZEROPLUS_FF=y
CONFIG_HID_ZYDACRON=y
CONFIG_HID_SENSOR_HUB=y
CONFIG_USB=y
CONFIG_USB_ANNOUNCE_NEW_DEVICES=y
CONFIG_USB_STORAGE=y
CONFIG_USB_SUSB_HDRC=y
CONFIG_HI6250_USB=y
CONFIG_USB_EHSET_TEST_FIXTURE=y
CONFIG_USB_GADGET=y
CONFIG_USB_GADGET_VBUS_DRAW=500
CONFIG_USB_G_ANDROID=y
CONFIG_USB_ANDROID_RNDIS_DWORD_ALIGNED=y
CONFIG_MMC=y
CONFIG_HISI_MMC_SECURE_RPMB=y
CONFIG_HUAWEI_SDCARD_DSM=y
CONFIG_HISI_PARTITION_HI6250=y
CONFIG_MMC_BLOCK_MINORS=48
# CONFIG_MMC_BLOCK_BOUNCE is not set
CONFIG_MMC_FFU=y
CONFIG_HW_SYSTEM_HW_WR_PROTECT=y
CONFIG_MMC_ARMMMCI=y
CONFIG_MMC_SDHCI=y
CONFIG_MMC_SDHCI_PLTFM=y
CONFIG_MMC_SDHCI_OF_ARASAN=y
CONFIG_MMC_DW=y
CONFIG_MMC_CQ_HCI=y
CONFIG_LEDS_TRIGGERS=y
CONFIG_LEDS_TRIGGER_TIMER=y
CONFIG_LEDS_HISI=y
CONFIG_SWITCH=y
CONFIG_RTC_CLASS=y
CONFIG_RTC_DRV_HISI_PMIC=y
CONFIG_DMADEVICES=y
CONFIG_HISI_DMA=y
CONFIG_HISI_DMA_NO_CCI=y
CONFIG_STAGING=y
CONFIG_ANDROID=y
CONFIG_ASHMEM=y
CONFIG_ANDROID_LOGGER=y
CONFIG_ANDROID_LOW_MEMORY_KILLER=y
CONFIG_HUAWEI_CACHED_APPS_KILL=y
CONFIG_ANDROID_INTF_ALARM_DEV=y
CONFIG_SYNC=y
CONFIG_SW_SYNC=y
CONFIG_SW_SYNC_USER=y
CONFIG_HUAWEI_RCC=y
CONFIG_ION_HISI=y
CONFIG_PASR=y
CONFIG_HISI_PASR=y
CONFIG_COMMON_CLK_DEBUG=y
CONFIG_HISI_CLK=y
CONFIG_HISI_HI6250_CLK=y
CONFIG_HISI_CLK_MAILBOX_SUPPORT=y
CONFIG_HISI_CLK_DEBUG=y
CONFIG_HWSPINLOCK_HISI=y
CONFIG_HWSPINLOCK_HISI_DEBUG=y
CONFIG_HISI_IOMMU=y
CONFIG_HISI_REMOTEPROC=y
CONFIG_HISTAR_ISP=y
CONFIG_PM_DEVFREQ=y
CONFIG_DEVFREQ_GOV_MALI_ONDEMAND=y
CONFIG_HISI_DDR_DEVFREQ=y
CONFIG_MALI_PLATFORM_HI6250=y
CONFIG_MALI_MIDGARD=y
CONFIG_MALI_MIDGARD_RT_PM=y
CONFIG_MALI_PM_DEMAND=y
CONFIG_HISILICON_PLATFORM=y
CONFIG_HISILICON_PLATFORM_ADC=y
CONFIG_HISI_HKADC=y
CONFIG_HISILICON_PLATFORM_DDRC=y
CONFIG_HISI_DDRC_SEC=y
CONFIG_HIFI_DSP_ONE_TRACK=y
CONFIG_HI3XXX_EFUSE=y
CONFIG_HISILICON_PLATFORM_MAINTAIN=y
CONFIG_HISI_BB=y
CONFIG_HISI_BB_DEBUG=y
CONFIG_HISI_LPMCU_BB=y
CONFIG_HISI_HIFI_BB=y
CONFIG_HISI_ISP_RDR=y
CONFIG_HISI_BOOT_TIME=y
CONFIG_HISI_LOWMEM_DBG=y
CONFIG_BALONG_OAM_PS=y
CONFIG_IPC_DRIVER=y
CONFIG_ICC_BALONG=y
CONFIG_SEC_CALL=y
CONFIG_HARD_TIMER=y
CONFIG_SOFT_TIMER=y
CONFIG_BBP_TIMER=y
CONFIG_BALONG_MODEM_RESET=y
CONFIG_RFILE_SUPPORT=y
CONFIG_NVIM=y
CONFIG_NVIM_TEST=y
CONFIG_HW_IP_BASE_ADDR=y
CONFIG_BALONG_MODEM_ONOFF=y
CONFIG_EFUSE_BALONG_AGENT=y
CONFIG_IMAGE_LOAD=y
CONFIG_UDI_SUPPORT=y
CONFIG_MEM_BALONG=y
CONFIG_SYNC_BALONG=y
CONFIG_IPF_SUPPORT=y
CONFIG_PSAM_SUPPORT=y
CONFIG_BALONG_EASY_SHELL=y
CONFIG_PM_OM_BALONG=y
CONFIG_PMIC_OCP=y
CONFIG_HI3XXX_SIM_HOTPLUG=y
CONFIG_HIFI_MAILBOX=y
CONFIG_HIFI_IPC=y
CONFIG_HIFI_IPC_6250=y
CONFIG_HISILICON_PLATFORM_MAILBOX=y
CONFIG_HISI_MAILBOX=y
CONFIG_HISI_RPROC=y
CONFIG_HISI_NOC=y
CONFIG_HISI_NOC_HI6250_PLATFORM=y
CONFIG_HISILICON_PLATFORM_TELE_MNTN=y
CONFIG_HISILICON_PLATFORM_HI3XXX=y
CONFIG_HI3XXX_POWER_OFF=y
CONFIG_HI3XXX_CMDLINE_PARSE=y
CONFIG_HISI_SR=y
CONFIG_HISI_SR_DEBUG=y
CONFIG_HISI_SR_DEBUG_SLEEP=y
CONFIG_HISI_LPM3_DEBUG=y
CONFIG_HISI_BOOST5V_CONTROL=y
CONFIG_HISI_AXI=y
CONFIG_HI6402_HIFI_MISC=y
CONFIG_HISI_SR_SYNC=y
CONFIG_HISI_WATCHPOINT_CB=y
CONFIG_HISILICON_PLATFORM_MISC=y
CONFIG_HISILICON_PLATFORM_RSVMAP_CHECK=y
CONFIG_HISI_HMPTH_SET=y
CONFIG_HISILICON_PLATFORM_KERNELDUMP=y
CONFIG_HISI_KERNELDUMP=y
CONFIG_HISI_FLP=y
CONFIG_SYNAPTICS_TS=y
CONFIG_SYNAPTICS_LCD_TYPE=y
CONFIG_CYPRESS_TS=y
CONFIG_TOUCHSCREEN_CYPRESS_CYTTSP5=y
CONFIG_TOUCHSCREEN_CYPRESS_CYTTSP5_DEVICETREE_SUPPORT=y
CONFIG_TOUCHSCREEN_CYPRESS_CYTTSP5_I2C=y
CONFIG_TOUCHSCREEN_CYPRESS_CYTTSP5_MT_B=y
CONFIG_TOUCHSCREEN_CYPRESS_CYTTSP5_BUTTON=y
CONFIG_TOUCHSCREEN_CYPRESS_CYTTSP5_DEVICE_ACCESS=y
CONFIG_TOUCHSCREEN_CYPRESS_CYTTSP5_LOADER=y
CONFIG_TOUCHSCREEN_CYPRESS_CYTTSP5_BINARY_FW_UPGRADE=y
CONFIG_LOAD_IMAGE=y
CONFIG_HISI_PERFHUB=y
# CONFIG_HISILICON_FREQDUMP is not set
CONFIG_HISI_HILOG=y
CONFIG_SECURE_EXTENSION=y
CONFIG_TZDRIVER=y
CONFIG_TEELOG=y
CONFIG_TEE_TUI=y
CONFIG_HISI_SPI_SMC=y
CONFIG_HISI_CCI_EXTRA=y
# CONFIG_GATOR is not set
CONFIG_ANDROID_BINDER_IPC=y
CONFIG_HUAWEI_PLATFORM=y
CONFIG_BCMGPS=y
CONFIG_HWCONNECTIVITY=y
CONFIG_SENSORHUB_FEATURE_SUPPORT=y
CONFIG_FINGERPRINT=y
CONFIG_INPUTHUB=y
CONFIG_IOM3_RECOVERY=y
CONFIG_HUAWEI_TS=y
CONFIG_HUAWEI_TP_COLOR_INFO=y
CONFIG_NEMO_TOUCH_FW=y
CONFIG_VENUS_TOUCH_FW=y
CONFIG_LOGGER_EXTEND=y
CONFIG_LOG_SWITCH=y
CONFIG_LOG_EXCEPTION=y
CONFIG_LOG_JANK=y
CONFIG_PN547_NFC_64=y
CONFIG_V8R2_NFC=y
CONFIG_SWITCH_FSA9685=y
CONFIG_SWITCH_USB=y
CONFIG_SWITCH_USB_CLS=y
CONFIG_HUAWEI_LCD_PANEL=y
CONFIG_HUAWEI_OCP=y
CONFIG_MAX98925=y
CONFIG_MAXIM=y
CONFIG_DEVICEBOXID=y
CONFIG_TFA9895=y
CONFIG_ANC_HS_INTERFACE=y
CONFIG_ANC_HS=y
CONFIG_HUAWEI_KSTATE=y
CONFIG_HUAWEI_BASTET=y
CONFIG_HUAWEI_MSG_POLICY=y
CONFIG_HW_ANTENNA_BOARD_MATCH=y
CONFIG_HW_ANTENNA_BOARD_ADC_MATCH=y
CONFIG_HUAWEI_DSM=y
CONFIG_HWTC=y
CONFIG_CONNECTIVITY_HI110X=y
CONFIG_EXT2_FS=y
CONFIG_EXT3_FS=y
# CONFIG_EXT3_DEFAULTS_TO_ORDERED is not set
# CONFIG_EXT3_FS_XATTR is not set
CONFIG_EXT4_FS=y
CONFIG_EXT4_FS_POSIX_ACL=y
CONFIG_EXT4_FS_SECURITY=y
CONFIG_FUSE_FS=y
CONFIG_CUSE=y
CONFIG_MSDOS_FS=y
CONFIG_VFAT_FS=y
CONFIG_EXFAT_FS=y
CONFIG_NTFS_FS=y
CONFIG_NTFS_RW=y
CONFIG_PROC_APP_INFO=y
CONFIG_DDR_INFO=y
CONFIG_TMPFS=y
CONFIG_CRAMFS=y
CONFIG_PSTORE=y
CONFIG_PSTORE_CONSOLE=y
CONFIG_PSTORE_RAM=y
CONFIG_NFS_FS=y
CONFIG_ROOT_NFS=y
CONFIG_NLS_CODEPAGE_437=y
CONFIG_NLS_ISO8859_1=y
CONFIG_NLS_UTF8=y
CONFIG_PRINTK_TIME=y
CONFIG_PRINTK_EXTENSION=y
CONFIG_MAGIC_SYSRQ=y
CONFIG_DETECT_HUNG_TASK=y
CONFIG_HW_DETECT_HUNG_TASK=y
# CONFIG_SCHED_DEBUG is not set
CONFIG_SCHEDSTATS=y
CONFIG_DEBUG_SPINLOCK=y
CONFIG_DEBUG_INFO=y
CONFIG_RCU_CPU_STALL_INFO=y
CONFIG_ENABLE_DEFAULT_TRACERS=y
CONFIG_ATOMIC64_SELFTEST=y
CONFIG_DEBUG_RODATA=y
CONFIG_SECURITY=y
CONFIG_SECURITY_NETWORK=y
CONFIG_SECURITY_SELINUX=y
CONFIG_HUAWEI_SELINUX_DSM=y
CONFIG_CRYPTO_TEST=m
CONFIG_CRYPTO_CCM=y
CONFIG_CRYPTO_GCM=y
CONFIG_CRYPTO_CTS=y
CONFIG_CRYPTO_XTS=y
CONFIG_CRYPTO_CMAC=y
CONFIG_CRYPTO_XCBC=y
CONFIG_CRYPTO_SHA256=y
CONFIG_CRYPTO_SHA512=y
CONFIG_CRYPTO_TWOFISH=y
CONFIG_CRYPTO_ANSI_CPRNG=y
CONFIG_CRYPTO_USER_API_HASH=y
CONFIG_CRYPTO_USER_API_SKCIPHER=y
CONFIG_ARM64_CRYPTO=y
CONFIG_CRYPTO_SHA1_ARM64_CE=y
CONFIG_CRYPTO_SHA2_ARM64_CE=y
CONFIG_CRYPTO_GHASH_ARM64_CE=y
CONFIG_CRYPTO_AES_ARM64_CE=y
CONFIG_CRYPTO_AES_ARM64_CE_CCM=y
CONFIG_CRYPTO_AES_ARM64_CE_BLK=y
CONFIG_CRYPTO_AES_ARM64_NEON_BLK=y
CONFIG_THUNDERPLUG_CONTROL=y
```
